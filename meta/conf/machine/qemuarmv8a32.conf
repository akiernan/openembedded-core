## meta/conf/machine/qemuarmv8a32.conf
```bitbake
#@TYPE: Machine
#@NAME: QEMU ARMv8 AArch32 machine on Cortex-A32
#@DESCRIPTION: Machine configuration for running an AArch32 system on QEMU

DEFAULTTUNE = "cortexa32-crypto"

require conf/machine/include/arm/armv8a/tune-cortexa32.inc
require conf/machine/include/qemu.inc

KERNEL_IMAGETYPE = "zImage"

PREFERRED_PROVIDER_virtual/bootloader ?= "u-boot"
UBOOT_MACHINE ?= "qemu_arm_defconfig"

SERIAL_CONSOLES ?= "115200;ttyAMA0 115200;hvc0"

# For runqemu
QB_SYSTEM_NAME = "qemu-system-arm"
QB_MACHINE = "-machine virt"
# QEMU doesn't know about Cortex-A32
QB_CPU = "-cpu max"
QB_SMP ?= "-smp 4"
QB_CPU_KVM = "-cpu host -machine gic-version=3"
# For graphics to work we need to define the VGA device as well as the necessary USB devices
QB_GRAPHICS = "-device virtio-gpu-pci"
QB_OPT_APPEND = "-device qemu-xhci -device usb-tablet -device usb-kbd"
# Virtio Networking support
QB_TAP_OPT = "-netdev tap,id=net0,ifname=@TAP@,script=no,downscript=no"
QB_NETWORK_DEVICE = "-device virtio-net-pci,netdev=net0,mac=@MAC@"
# Virtio block device
QB_ROOTFS_OPT = "-drive id=disk0,file=@ROOTFS@,if=none,format=raw -device virtio-blk-pci,drive=disk0"
# Virtio serial console
QB_SERIAL_OPT = "-device virtio-serial-pci -chardev null,id=virtcon -device virtconsole,chardev=virtcon"
QB_TCPSERIAL_OPT = "-device virtio-serial-pci -chardev socket,id=virtcon,port=@PORT@,host=127.0.0.1,nodelay=on -device virtconsole,chardev=virtcon"

KMACHINE:qemuarmv8a32 = "qemuarma15"
```
